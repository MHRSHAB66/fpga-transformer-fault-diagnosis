## artifacts/preempt_rt_candidate_20261024/image_rt.its
```
/dts-v1/;
/ {
    description = "PREEMPT_RT candidate (linux-xlnx xilinx-v2018.3 + patch-4.14-rt1), board DTB from original image.ub";
    #address-cells = <1>;
    images {
        kernel@0 {
            description = "Linux Kernel 4.14.0-rt1 PREEMPT_RT";
            data = /incbin/("build-rt/arch/arm/boot/zImage");
            type = "kernel"; arch = "arm"; os = "linux"; compression = "none";
            load = <0x80000>; entry = <0x80000>;
            hash@1 { algo = "sha1"; };
        };
        fdt@0 {
            description = "Flattened Device Tree blob (unchanged, from original image.ub)";
            data = /incbin/("orig_system.dtb");
            type = "flat_dt"; arch = "arm"; compression = "none";
            hash@1 { algo = "sha1"; };
        };
    };
    configurations {
        default = "conf@1";
        conf@1 { description = "Boot Linux kernel with FDT blob"; kernel = "kernel@0"; fdt = "fdt@0"; };
    };
};
```
